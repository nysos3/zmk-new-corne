## config/west.yml
```yaml
manifest:
  remotes:
    - name: zmkfirmware
      url-base: https://github.com/zmkfirmware
      # Additional modules containing boards/shields/custom code can be listed here as well.
      # See:
      # - https://zmk.dev/docs/features/modules
      # - https://docs.zephyrproject.org/3.5.0/develop/west/manifest.html#projects
    - name: m165437 # - https://github.com/M165437/nice-view-gem
      url-base: https://github.com/M165437 # - https://github.com/M165437/nice-view-gem
  projects:
    - name: eyelash_corne
      url: https://github.com/a741725193/zmk-new_corne
      revision: main
    - name: zmk
      remote: zmkfirmware
      revision: main
      import: app/west.yml
    - name: nice-view-gem # - https://github.com/M165437/nice-view-gem
      remote: m165437 # - https://github.com/M165437/nice-view-gem
      revision: main # - https://github.com/M165437/nice-view-gem
  self:
    path: config
```
